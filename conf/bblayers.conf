## conf/bblayers.conf
```bitbake
# POKY_BBLAYERS_CONF_VERSION is increased each time build/conf/bblayers.conf
# changes incompatibly
POKY_BBLAYERS_CONF_VERSION = "2"

BBPATH = "${TOPDIR}"
BBFILES ?= ""

BBLAYERS ?= " \
  /home/abirami/YOCTO/poky/meta \
  /home/abirami/YOCTO/poky/meta-poky \
  /home/abirami/YOCTO/poky/meta-yocto-bsp \
  "
```
